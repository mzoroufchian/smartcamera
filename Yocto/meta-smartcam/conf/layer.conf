## Yocto/meta-smartcam/conf/layer.conf
```bitbake
# We have a conf and classes directory, add to BBPATH
BBPATH .= ":${LAYERDIR}"

# We have recipes-* directories, add to BBFILES
BBFILES += "${LAYERDIR}/recipes-*/*/*.bb \
         ${LAYERDIR}/recipes-*/*/*.bbappend"

BBFILE_COLLECTIONS += "smartcam"
BBFILE_PATTERN_smartcam = "^${LAYERDIR}/"
BBFILE_PRIORITY_smartcam = "4"
LAYERVERSION_smartcam = "1"

LAYERSERIES_COMPAT_smartcam = "thud"
```

## Yocto/meta-smartcam/conf/machine/zybo-smartcam.conf
```bitbake
#@TYPE: Machine
#@NAME: zybo-smartcam
#@DESCRIPTION: Machine support for zybo-smartcam project.
#

SOC_VARIANT ?= "7z"

require conf/machine/include/tune-zynq.inc
require conf/machine/include/machine-xilinx-overrides.inc
require conf/machine/include/machine-xilinx-default.inc

PREFERRED_PROVIDER_virtual/kernel ?= "linux-xlnx"
PREFERRED_PROVIDER_virtual/bootloader ?= "u-boot"

MACHINE_FEATURES = "ext2 vfat usbhost usbgadget keyboard screen alsa sdio"
SERIAL_CONSOLE = "115200 ttyPS0"

MACHINE_ESSENTIAL_EXTRA_RDEPENDS += "device-tree"

MACHINE_DEVICETREE = "smartcam-system.dts"

UBOOT_MACHINE = "zynq_zybo_config"
SPL_BINARY = "spl/boot.bin"

FORCE_PLATFORM_INIT = "1"

EXTRA_IMAGEDEPENDS += " \
		u-boot-zynq-uenv \
		virtual/boot-bin \
		virtual/bitstream \
		"
 
IMAGE_BOOT_FILES += " \
		boot.bin \
		bitstream \
		"

CORE_IMAGE_EXTRA_INSTALL += " face-rec"
```
